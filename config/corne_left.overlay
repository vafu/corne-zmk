#include "corne_enc.dtsi" 

&encoder_left {
    status = "okay";
    a-gpios = <&pro_micro 10 (GPIO_ACTIVE_LOW | GPIO_PULL_UP)>; 
    b-gpios = <&pro_micro 16 (GPIO_ACTIVE_LOW | GPIO_PULL_UP)>; 
};

&direct_keys_left {
    status = "okay";
    input-gpios = <&pro_micro 0 (GPIO_ACTIVE_LOW | GPIO_PULL_UP)>;
};

&kscan_composite {
    direct_left {
        kscan = <&direct_keys_left>;
        row-offset = <4>;
        col-offset = <5>; 
    };
};
