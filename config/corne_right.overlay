#include "corne_enc.dtsi" // Include the same shared template

// Enable and configure the right-side hardware
&encoder_right {
    status = "okay";
    a-gpios = <&pro_micro 9 (GPIO_ACTIVE_LOW | GPIO_PULL_UP)>; // CHANGE THIS: Right A pin
    b-gpios = <&pro_micro 8 (GPIO_ACTIVE_LOW | GPIO_PULL_UP)>;  // CHANGE THIS: Right B pin
};

&encoder_transform {
    col-offset = <6>;
};

&direct_keys {
    input-gpios = <&pro_micro 16 (GPIO_ACTIVE_LOW | GPIO_PULL_UP)>;
}
